## coap/esp-idf/coap_client/main/Kconfig.projbuild
```kconfig
menu "Wi-Fi"
    config WIFI_SSID
        string "SSID (nombre de la red)"
        default "mi-red"
        help
            El ESP32 clásico solo se conecta a redes de 2,4 GHz.
    config WIFI_PASSWORD
        string "Clave"
        default ""
        help
            Vacía para una red abierta. Queda en sdkconfig, que no se sube al repositorio.
endmenu

menu "Ejemplo CoAP cliente"
    config COAP_SERVER_URI
        string "URI del servidor CoAP"
        default "coap://192.168.1.10"
        help
            Servidor TypeScript (npm run servidor en coap/ts) o el ESP32 con coap_server.
    config TEMP_UMBRAL
        int "Umbral de temperatura (°C) para encender el LED remoto"
        default 23
endmenu
```

## coap/esp-idf/coap_server/main/Kconfig.projbuild
```kconfig
menu "Wi-Fi"
    config WIFI_SSID
        string "SSID (nombre de la red)"
        default "mi-red"
        help
            El ESP32 clásico solo se conecta a redes de 2,4 GHz.
    config WIFI_PASSWORD
        string "Clave"
        default ""
        help
            Vacía para una red abierta. Queda en sdkconfig, que no se sube al repositorio.
endmenu

menu "Ejemplo CoAP"
    config LED_GPIO
        int "GPIO del LED"
        default 2
endmenu
```
